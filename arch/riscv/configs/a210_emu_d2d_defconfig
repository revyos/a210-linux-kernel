## arch/riscv/configs/virt_defconfig
```kconfig
# CONFIG_LOCALVERSION_AUTO is not set
CONFIG_SYSVIPC=y
CONFIG_POSIX_MQUEUE=y
CONFIG_AUDIT=y
CONFIG_NO_HZ_IDLE=y
CONFIG_HIGH_RES_TIMERS=y
CONFIG_BPF_SYSCALL=y
CONFIG_PREEMPT=y
CONFIG_TASKSTATS=y
CONFIG_TASK_DELAY_ACCT=y
CONFIG_TASK_XACCT=y
CONFIG_TASK_IO_ACCOUNTING=y
CONFIG_CGROUPS=y
CONFIG_CGROUP_SCHED=y
CONFIG_CPUSETS=y
CONFIG_CGROUP_BPF=y
CONFIG_NAMESPACES=y
CONFIG_USER_NS=y
CONFIG_CHECKPOINT_RESTORE=y
CONFIG_BLK_DEV_INITRD=y
# CONFIG_RD_BZIP2 is not set
# CONFIG_RD_LZMA is not set
# CONFIG_RD_XZ is not set
# CONFIG_INITRAMFS_PRESERVE_MTIME is not set
CONFIG_CC_OPTIMIZE_FOR_SIZE=y
CONFIG_EXPERT=y
# CONFIG_BUG is not set
CONFIG_KALLSYMS_ALL=y
CONFIG_PERF_EVENTS=y
CONFIG_ARCH_ZHIHE=y
CONFIG_NONPORTABLE=y
CONFIG_SMP=y
CONFIG_NR_CPUS=16
CONFIG_NUMA=y
CONFIG_HZ_100=y
# CONFIG_EFI is not set
# CONFIG_SUSPEND is not set
CONFIG_KPROBES=y
# CONFIG_STRICT_KERNEL_RWX is not set
# CONFIG_GCC_PLUGINS is not set
CONFIG_MODULES=y
CONFIG_MODULE_UNLOAD=y
# CONFIG_BLK_DEBUG_FS is not set
CONFIG_BINFMT_MISC=m
CONFIG_CMA=y
CONFIG_CMA_DEBUGFS=y
CONFIG_CMA_AREAS=16
CONFIG_NET=y
CONFIG_PACKET=y
CONFIG_UNIX=y
CONFIG_INET=y
CONFIG_IP_PNP=y
CONFIG_IP_PNP_DHCP=y
CONFIG_IP_PNP_BOOTP=y
CONFIG_IP_PNP_RARP=y
# CONFIG_IPV6 is not set
CONFIG_DNS_RESOLVER=y
# CONFIG_WIRELESS is not set
# CONFIG_ETHTOOL_NETLINK is not set
CONFIG_DEVTMPFS=y
CONFIG_DEVTMPFS_MOUNT=y
CONFIG_BLK_DEV_LOOP=y
CONFIG_BLK_DEV_RAM=y
CONFIG_VIRTIO_BLK=y
CONFIG_PA_BLK_DEV=y
CONFIG_IO_EVENT_WRAPER=y
CONFIG_NETDEVICES=y
CONFIG_VIRTIO_NET=y
# CONFIG_NET_VENDOR_ALACRITECH is not set
# CONFIG_NET_VENDOR_AMAZON is not set
# CONFIG_NET_VENDOR_AQUANTIA is not set
# CONFIG_NET_VENDOR_ARC is not set
# CONFIG_NET_VENDOR_ASIX is not set
# CONFIG_NET_VENDOR_BROADCOM is not set
# CONFIG_NET_VENDOR_CADENCE is not set
# CONFIG_NET_VENDOR_CAVIUM is not set
# CONFIG_NET_VENDOR_CORTINA is not set
# CONFIG_NET_VENDOR_DAVICOM is not set
# CONFIG_NET_VENDOR_ENGLEDER is not set
# CONFIG_NET_VENDOR_EZCHIP is not set
# CONFIG_NET_VENDOR_FUNGIBLE is not set
# CONFIG_NET_VENDOR_GOOGLE is not set
# CONFIG_NET_VENDOR_HUAWEI is not set
# CONFIG_NET_VENDOR_INTEL is not set
# CONFIG_NET_VENDOR_LITEX is not set
# CONFIG_NET_VENDOR_MARVELL is not set
# CONFIG_NET_VENDOR_MELLANOX is not set
# CONFIG_NET_VENDOR_MICREL is not set
# CONFIG_NET_VENDOR_MICROCHIP is not set
# CONFIG_NET_VENDOR_MICROSEMI is not set
# CONFIG_NET_VENDOR_MICROSOFT is not set
# CONFIG_NET_VENDOR_NI is not set
# CONFIG_NET_VENDOR_NATSEMI is not set
# CONFIG_NET_VENDOR_NETRONOME is not set
# CONFIG_NET_VENDOR_PENSANDO is not set
# CONFIG_NET_VENDOR_QUALCOMM is not set
# CONFIG_NET_VENDOR_RENESAS is not set
# CONFIG_NET_VENDOR_ROCKER is not set
# CONFIG_NET_VENDOR_SAMSUNG is not set
# CONFIG_NET_VENDOR_SEEQ is not set
# CONFIG_NET_VENDOR_SOLARFLARE is not set
# CONFIG_NET_VENDOR_SOCIONEXT is not set
# CONFIG_NET_VENDOR_STMICRO is not set
# CONFIG_NET_VENDOR_SYNOPSYS is not set
# CONFIG_NET_VENDOR_VERTEXCOM is not set
# CONFIG_NET_VENDOR_VIA is not set
# CONFIG_NET_VENDOR_WANGXUN is not set
# CONFIG_NET_VENDOR_WIZNET is not set
# CONFIG_NET_VENDOR_XILINX is not set
CONFIG_PHYLIB=y
# CONFIG_WLAN is not set
# CONFIG_INPUT_KEYBOARD is not set
# CONFIG_INPUT_MOUSE is not set
# CONFIG_SERIO is not set
CONFIG_VT_HW_CONSOLE_BINDING=y
CONFIG_SERIAL_8250=y
# CONFIG_SERIAL_8250_DEPRECATED_OPTIONS is not set
CONFIG_SERIAL_8250_CONSOLE=y
CONFIG_SERIAL_8250_NR_UARTS=6
CONFIG_SERIAL_8250_RUNTIME_UARTS=6
CONFIG_SERIAL_8250_DW=y
CONFIG_SERIAL_OF_PLATFORM=y
CONFIG_HW_RANDOM=y
# CONFIG_PTP_1588_CLOCK is not set
CONFIG_PINCTRL=y
CONFIG_GPIOLIB=y
CONFIG_GPIO_SYSFS=y
# CONFIG_HWMON is not set
CONFIG_MFD_SYSCON=y
CONFIG_DRM=y
CONFIG_DRM_VKMS=y
# CONFIG_VGA_CONSOLE is not set
# CONFIG_HID is not set
# CONFIG_USB_SUPPORT is not set
CONFIG_MMC=y
CONFIG_MMC_SDHCI=y
CONFIG_MMC_SDHCI_PLTFM=y
CONFIG_MMC_SDHCI_OF_DWCMSHC=y
CONFIG_NEW_LEDS=y
CONFIG_LEDS_CLASS=y
CONFIG_RTC_CLASS=y
CONFIG_RTC_DRV_GOLDFISH=y
CONFIG_DMADEVICES=y
CONFIG_DW_AXI_DMAC=y
CONFIG_DMATEST=y
CONFIG_SW_SYNC=y
CONFIG_UDMABUF=y
CONFIG_DMABUF_SELFTESTS=m
CONFIG_VIRTIO_MMIO=y
# CONFIG_VHOST_MENU is not set
CONFIG_HWSPINLOCK=y
CONFIG_PHY_DW_DPHY=y
CONFIG_EXT4_FS=y
CONFIG_EXT4_FS_POSIX_ACL=y
CONFIG_EXPORTFS_BLOCK_OPS=y
CONFIG_AUTOFS_FS=y
CONFIG_FUSE_FS=m
CONFIG_OVERLAY_FS=y
CONFIG_VFAT_FS=m
CONFIG_EXFAT_FS=m
CONFIG_NTFS_FS=m
CONFIG_TMPFS=y
CONFIG_TMPFS_POSIX_ACL=y
CONFIG_HUGETLBFS=y
CONFIG_CONFIGFS_FS=y
CONFIG_EROFS_FS=y
CONFIG_NFS_FS=y
CONFIG_NFS_V3_ACL=y
CONFIG_NFS_V4=y
CONFIG_NFS_SWAP=y
CONFIG_NFS_V4_1=y
CONFIG_NFS_V4_2=y
CONFIG_NFS_V4_1_MIGRATION=y
CONFIG_ROOT_NFS=y
CONFIG_NFS_USE_LEGACY_DNS=y
# CONFIG_RPCSEC_GSS_KRB5 is not set
CONFIG_NLS=y
CONFIG_NLS_CODEPAGE_437=m
CONFIG_NLS_ISO8859_1=m
CONFIG_NLS_UTF8=m
# CONFIG_CRYPTO_MANAGER_DISABLE_TESTS is not set
CONFIG_CRYPTO_DEV_ZHIHE=m
CONFIG_DMA_CMA=y
CONFIG_CMA_SIZE_MBYTES=32
CONFIG_PRINTK_TIME=y
CONFIG_DYNAMIC_DEBUG=y
# CONFIG_DEBUG_MISC is not set
CONFIG_DEBUG_INFO_DWARF_TOOLCHAIN_DEFAULT=y
CONFIG_MAGIC_SYSRQ=y
CONFIG_DEBUG_FS=y
CONFIG_DETECT_HUNG_TASK=y
CONFIG_DEBUG_ATOMIC_SLEEP=y
# CONFIG_RCU_TRACE is not set
# CONFIG_RUNTIME_TESTING_MENU is not set
```

## drivers/clk/zhihe/Kconfig
```kconfig
# SPDX-License-Identifier: GPL-2.0

config ZHIHE_CLK
	bool
	def_bool ARCH_ZHIHE

config CLK_A210
	bool "Zhihe A210 Clock Driver"
	depends on ARCH_ZHIHE
	default n
	help
	    Build the driver for zhihe A210 Clock Driver
```

## drivers/crypto/zhihe/Kconfig
```kconfig
# SPDX-License-Identifier: GPL-2.0-only
config CRYPTO_DEV_ZHIHE
	tristate "zhihe crypto driver"
	depends on CRYPTO
	select CRYPTO_ENGINE
	select CRYPTO_AEAD
	select CRYPTO_AEAD2
	select CRYPTO_RSA
	select CRYPTO_ECC
	select CRYPTO_ECDH
	select CRYPTO_SM2
	select CRYPTO_CURVE25519
	select CRYPTO_AES
	select CRYPTO_DES
	select CRYPTO_SM4
	select CRYPTO_SM4_GENERIC
	select CRYPTO_CTR
	select CRYPTO_ECB
	select CRYPTO_OFB
	select CRYPTO_XTS
	select CRYPTO_GCM
	select CRYPTO_SHA1
	select CRYPTO_SHA256
	select CRYPTO_SHA512
	select CRYPTO_SHA3
	select CRYPTO_SM3
	select CRYPTO_SM3_GENERIC
	select CRYPTO_HMAC
	select CRYPTO_LIB_CURVE25519_GENERIC
	select CRYPTO_LIB_DES
	select CRYPTO_USER
	select CRYPTO_USER_API
	select CRYPTO_USER_API_AEAD
	select CRYPTO_USER_API_RNG
	select CRYPTO_USER_API_HASH
	select CRYPTO_USER_API_SKCIPHER
	help
	  This driver provides support for zhihe crypto device. If you
	  choose 'M' here, this module will be called zhihe_crypto.
```

## drivers/firmware/zhihe/Kconfig
```kconfig
# SPDX-License-Identifier: GPL-2.0-only
config A210_AON
	bool "A210 Aon Protocol driver"
	depends on A210_MBOX
	default y
	help
	  ZHIHE A210 Aon is a low-level system function which runs a dedicated
	  ZHIHE riscv E902 core to provide power, clock and resource management.

	  This driver manages the IPC interface between host cpu liks thead
	  and the Aon firmware running on thead riscv E902 core.
```

## drivers/iommu/riscv/Kconfig
```kconfig
# SPDX-License-Identifier: GPL-2.0-only
# RISC-V IOMMU support

config RISCV_IOMMU
	bool "RISC-V IOMMU driver"
	depends on RISCV
	select IOMMU_API
	select IOMMU_DMA
	select IOMMU_IOVA
	select IOMMU_IO_PGTABLE
	help
	  Support for devices following RISC-V IOMMU specification.

	  If unsure, say N here.
```

## drivers/iopmp/Kconfig
```kconfig
# SPDX-License-Identifier: GPL-2.0-only
menuconfig IOPMP
	bool "iopmp Support"
	help
	  Support for iopmp devices 
if IOPMP
menu "Generic IOPMP Support"

config ZH_IOPMP
	tristate "ZhiHe iopmp Support"
	depends on ARCH_ZHIHE || COMPILE_TEST
	help
	Say Y here to include support for zhihe iopmp found on found on
	P100 fullmask devices
	To compile this driver as a module, choose M here: the module
	will be called zh-iopmp.

endmenu

endif # IOPMP
```

## drivers/soc/zhihe/Kconfig
```kconfig
# SPDX-License-Identifier: GPL-2.0-only

menu "ZHIHE SoC drivers"

config P100_MEMTESTER
	tristate "ZHIHE P100 memtester support"
	default y
	help
	  This driver supports P100 memtester feature.

config P100_POWER_DOMAIN
	bool "P100 Power Domain driver"
	depends on PM
	select PM_GENERIC_DOMAINS
	default y
	help
	  This is the power domain driver that controls PCU/PPU for P100 Soc.

config P100_BMU
        tristate "p100-bmu driver"
        default n
        help
          This driver provides support for p100 bmu.

endmenu
```

## sound/soc/zhihe/Kconfig
```kconfig
# SPDX-License-Identifier: GPL-2.0-only
config SND_SOC_ZHIHE
	tristate "Zhihe Dummy PCM And PCM DMA Support"
	default n

config SND_SOC_ZHIHE_I2S
	tristate "Zhihe 2-Channel I2S Driver Support"
	select SND_SOC_GENERIC_DMAENGINE_PCM
	select SND_SOC_ZHIHE
	default n
	help
	  Say Y or M if you want to add support for codecs or HDMI PCM
	  attached to the SND_SOC_ZHIHE_I2S interface.

config SND_SOC_ZHIHE_TDM
	tristate "Zhihe TDM Driver Support"
	select SND_SOC_GENERIC_DMAENGINE_PCM
	select SND_SOC_ZHIHE
	default n
	help
	  Say Y or M if you want to add support for codecs
	  attached to the SND_SOC_ZHIHE_TDM interface.
	  Codecs support up to 8 slots of recording.

config SND_SOC_ZHIHE_PDM
        tristate "Zhihe PDM Driver Support"
        select SND_SOC_GENERIC_DMAENGINE_PCM
	select SND_SOC_ZHIHE
	default n
        help
          Say Y or M if you want to add support for Digital Mic
          attached to the SND_SOC_ZHIHE_PDM interface.
          Codecs support up to 8 channels of recording.
```
